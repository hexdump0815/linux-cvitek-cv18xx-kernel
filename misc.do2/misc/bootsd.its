## misc.do2/misc/bootsd.its
```
/dts-v1/;

/ {
	description = "milkv duo 256m kernel and fdt";
	#address-cells = <2>;

	images {
		kernel {
			description = "kernel";
			data = /incbin/("/compile/source/linux-milkv-do2/arch/riscv/boot/Image.lzma");
			type = "kernel";
			arch = "riscv";
			os = "linux";
			compression = "lzma";
			load = <0x0 0x80200000>;
			entry = <0x0 0x80200000>;
			hash {
				algo = "crc32";
			};
		};

		fdt {
			description = "fdt";
			data = /incbin/("/compile/source/linux-milkv-do2/arch/riscv/boot/dts/cvitek/cv1812cp_milkv_duo256m_sd.dtb");
			type = "flat_dt";
			arch = "riscv";
			compression = "none";
			hash {
				algo = "sha256";
			};
		};
	};

	configurations {
		config-cv1812cp_milkv_duo256m_sd {
			description = "milkv duo 256m kernel and fdt";
			kernel = "kernel";
			fdt = "fdt";
		};
	};
};
```

## misc.dos/misc/bootsd.its
```
/dts-v1/;

/ {
	description = "milkv duo s kernel and fdt";
	#address-cells = <2>;

	images {
		kernel {
			description = "kernel";
			data = /incbin/("/compile/source/linux-milkv-dos/arch/riscv/boot/Image.lzma");
			type = "kernel";
			arch = "riscv";
			os = "linux";
			compression = "lzma";
			load = <0x0 0x80200000>;
			entry = <0x0 0x80200000>;
			hash {
				algo = "crc32";
			};
		};

		fdt {
			description = "fdt";
			data = /incbin/("/compile/source/linux-milkv-dos/arch/riscv/boot/dts/cvitek/cv1813h_milkv_duos_sd.dtb");
			type = "flat_dt";
			arch = "riscv";
			compression = "none";
			hash {
				algo = "sha256";
			};
		};
	};

	configurations {
		config-cv1813h_milkv_duos_sd {
			description = "milkv duo s kernel and fdt";
			kernel = "kernel";
			fdt = "fdt";
		};
	};
};
```

## misc.duo/misc/bootsd.its
```
/dts-v1/;

/ {
	description = "milkv duo 64m kernel and fdt";
	#address-cells = <2>;

	images {
		kernel {
			description = "kernel";
			data = /incbin/("/compile/source/linux-milkv-duo/arch/riscv/boot/Image.lzma");
			type = "kernel";
			arch = "riscv";
			os = "linux";
			compression = "lzma";
			load = <0x0 0x80200000>;
			entry = <0x0 0x80200000>;
			hash {
				algo = "crc32";
			};
		};

		fdt {
			description = "fdt";
			data = /incbin/("/compile/source/linux-milkv-duo/arch/riscv/boot/dts/cvitek/cv1800b_milkv_duo_sd.dtb");
			type = "flat_dt";
			arch = "riscv";
			compression = "none";
			hash {
				algo = "sha256";
			};
		};
	};

	configurations {
		config-cv1800b_milkv_duo_sd {
			description = "milkv duo 64m kernel and fdt";
			kernel = "kernel";
			fdt = "fdt";
		};
	};
};
```
